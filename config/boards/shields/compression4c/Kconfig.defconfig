## config/boards/shields/compression4c/Kconfig.defconfig
```kconfig
if SHIELD_COMPRESSION4C_LEFT || SHIELD_COMPRESSION4C_RIGHT

config ZMK_KEYBOARD_NAME
    default "Compression 4C"

config ZMK_SPLIT
    default y

endif

config ZMK_IDLE_TIMEOUT
    default 300000
    
config ZMK_IDLE_SLEEP_TIMEOUT
    default 1800000

config ZMK_USB
    default y
```

## config/boards/shields/compression4c/Kconfig.shield
```kconfig
config SHIELD_COMPRESSION4C_LEFT
    def_bool $(shields_list_contains,compression4c_left)

config SHIELD_COMPRESSION4C_RIGHT
    def_bool $(shields_list_contains,compression4c_right)
```

## config/boards/shields/compression4c/dts/bindings/zmk,matrix-transform.yaml
```yaml
description: Matrix transform definition patch to allow key indexing bindings for ZMK Studio
compatible: "zmk,matrix-transform"
include: base.yaml
properties:
  "#key-cells":
    type: int
    required: true
    const: 2
```

## config/west.yml
```yaml
manifest:
  remotes:
    - name: zmkfirmware
      url-base: https://github.com/zmkfirmware
    - name: compression
      url-base: https://github.com/compressionKeyboards

  projects:
    - name: zmk
      remote: zmkfirmware
      revision: main
      import: app/west.yml
    # Inject the missing keyboard shield / board source folder module
    - name: compression4c
      remote: compression
      revision: main
      import: true
  self:
    path: config
```
